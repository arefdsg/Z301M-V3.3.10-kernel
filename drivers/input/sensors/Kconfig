## drivers/input/sensors/Kconfig
```kconfig
#
# Sensor drivers configuration
#

config HALL_SENSOR
       bool "Hall sensor"
       default n
```

## drivers/misc/mediatek/accelerometer/icm20608g/Kconfig
```kconfig
config MTK_ICM20608G
	bool "ICM20608 for MediaTek package"
	default n
	help
	  It support different accelerometer sensor.
          If this option is set,
	  it will support
          ICM20608 Accelerometer.
```

## drivers/misc/mediatek/gyroscope/icm20608gy/Kconfig
```kconfig
config MTK_ICM20608GY
        bool "ICM20608 for MediaTek package"
        default n
        help
        It support different gyroscope sensor.
        If this option is set,
	  	it will support
         ICM20608 gyroscope.
```

## drivers/usb/slimport/Kconfig
```kconfig
source "drivers/usb/slimport/Anx_Co3_Drv/Kconfig"
source "drivers/usb/slimport/Anx_Ohio_Drv/Kconfig"
```
